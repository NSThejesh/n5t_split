## config/boards/shields/corne/Kconfig.defconfig
```kconfig
if SHIELD_CORNE_LEFT

config ZMK_KEYBOARD_NAME
	default "Corne"

config ZMK_SPLIT_ROLE_CENTRAL
	default y

endif

if SHIELD_CORNE_LEFT || SHIELD_CORNE_RIGHT

config ZMK_SPLIT
	default y

if ZMK_DISPLAY

config I2C
	default y

config SSD1306
	default y

endif # ZMK_DISPLAY

if LVGL

config LV_Z_VDB_SIZE
	default 64

config LV_DPI_DEF
	default 148

config LV_Z_BITS_PER_PIXEL
	default 1

choice LV_COLOR_DEPTH
	default LV_COLOR_DEPTH_1
endchoice

endif # LVGL

endif

config CORNE_CUSTOM_DISPLAY
	bool "Custom Corne display"
	depends on ZMK_DISPLAY


# Gem-on-OLED options
if CORNE_CUSTOM_DISPLAY
config NICE_VIEW_GEM_WPM_FIXED_RANGE
	bool "Fixed range for WPM chart"
	default y
config NICE_VIEW_GEM_WPM_FIXED_RANGE_MAX
	int "Fixed range maximum"
	default 100
config NICE_VIEW_GEM_ANIMATION
	bool "Crystal animation on peripheral"
	default y
config NICE_VIEW_GEM_ANIMATION_FRAME
	int "Static frame if animation off"
	default 0
config NICE_VIEW_GEM_ANIMATION_MS
	int "Animation length in ms"
	default 960
config NICE_VIEW_WIDGET_INVERTED
	bool "Invert display colors"
	default n
endif
```
